
//=============================================================================
/*-------------------------------- Includes ---------------------------------*/
//=============================================================================
#include "task_mqtt_mng.h"

#include "stdlib.h"

/* Kernel */
#include "FreeRTOS.h"
#include "task.h"
#include "semphr.h"

/* SVMQTT */
#include "mqttmng.h"
#include "mqttmngConfig.h"
//=============================================================================

//=============================================================================
/*--------------------------------- Defines ---------------------------------*/
//=============================================================================

//=============================================================================

//=============================================================================
/*--------------------------------- Globals ---------------------------------*/
//=============================================================================
static SemaphoreHandle_t mutex;
//=============================================================================

//=============================================================================
/*-------------------------------- Prototypes -------------------------------*/
//=============================================================================
static int32_t taskMqttmngInit(void);
static int32_t taskMqttmngLock(uint32_t timeout);
static void taskMqttmngUnlock(void);
//=============================================================================

//=============================================================================
/*---------------------------------- Task -----------------------------------*/
//=============================================================================
//-----------------------------------------------------------------------------
void taskMqttmng(void *param){

    (void) param;

    if( taskMqttmngInit() != 0 ) exit (-1);

    while(1){
        mqttmngRun();
    }
}
//-----------------------------------------------------------------------------
//=============================================================================

//=============================================================================
/*---------------------------- Static functions -----------------------------*/
//=============================================================================
//-----------------------------------------------------------------------------
static int32_t taskMqttmngInit(void){
    
    int32_t status;

    mutex = xSemaphoreCreateMutex();
    if( mutex == NULL ) return -1;

    status = mqttmngInit(
        MQTT_MNG_CONFIG_DEV_ID, 0,
        taskMqttmngLock, taskMqttmngUnlock
    );

    return status;
}
//-----------------------------------------------------------------------------
static int32_t taskMqttmngLock(uint32_t timeout){

    if( xSemaphoreTake(mutex, timeout) != pdTRUE ) return -1;

    return 0;
}
//-----------------------------------------------------------------------------
static void taskMqttmngUnlock(void){
    
    xSemaphoreGive(mutex);
}
//-----------------------------------------------------------------------------
//=============================================================================
