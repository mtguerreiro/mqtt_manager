
//=============================================================================
/*-------------------------------- Includes ---------------------------------*/
//=============================================================================
#include "task_svmqtt.h"

#include "stdlib.h"

/* Kernel */
#include "freertos/FreeRTOS.h"
#include "freertos/task.h"
#include "freertos/semphr.h"

/* SVMQTT */
#include "mqttmng.h"
#include "mqttmngConfig.h"
//=============================================================================

//=============================================================================
/*--------------------------------- Defines ---------------------------------*/
//=============================================================================

//=============================================================================

//=============================================================================
/*--------------------------------- Globals ---------------------------------*/
//=============================================================================
static int32_t svmqttStatus = 1;

static SemaphoreHandle_t mutex;
//=============================================================================

//=============================================================================
/*-------------------------------- Prototypes -------------------------------*/
//=============================================================================
static int32_t taskSvqmttInit(void);
static int32_t taskSvmqttLock(uint32_t timeout);
static void taskSvmqttUnlock(void);
//=============================================================================

//=============================================================================
/*---------------------------------- Task -----------------------------------*/
//=============================================================================
//-----------------------------------------------------------------------------
void taskSvmqtt(void *param){

    printf("Initializing SVMQTT...\n\r");

    if( taskSvqmttInit() != 0 ) exit (-1);

    printf("SVMQTT initialized.\n\r");

    svmqttStatus = 0;

    while(1){
        mqttmngRun();
    }
}
//-----------------------------------------------------------------------------
int32_t taskSvmqttStatus(void){

    return svmqttStatus;
}
//-----------------------------------------------------------------------------
//=============================================================================

//=============================================================================
/*---------------------------- Static functions -----------------------------*/
//=============================================================================
//-----------------------------------------------------------------------------
static int32_t taskSvqmttInit(void){
    
    int32_t status;

    mutex = xSemaphoreCreateMutex();
    if( mutex == NULL ) return -1;

    status = mqttmngInit(taskSvmqttLock, taskSvmqttUnlock);

 	//mqttmngAddComponent(MQTT_MNG_COMP_1, (const char*)"temp1", (const char*)"temperature", (const char*)0);
	//mqttmngAddComponent(MQTT_MNG_COMP_2, (const char*)"led233", (const char*)"led", (const char*)"ri");


    return status;
}
//-----------------------------------------------------------------------------
static int32_t taskSvmqttLock(uint32_t timeout){

    if( xSemaphoreTake(mutex, timeout) != pdTRUE ) return -1;

    return 0;
}
//-----------------------------------------------------------------------------
static void taskSvmqttUnlock(void){
    
    xSemaphoreGive(mutex);
}
//-----------------------------------------------------------------------------
//=============================================================================
