
//=============================================================================
/*-------------------------------- Includes ---------------------------------*/
//=============================================================================
#include "task_svmqtt.h"

#include "stdlib.h"

/* Kernel */
#include "freertos/FreeRTOS.h"
#include "freertos/task.h"
#include "freertos/semphr.h"

/* SVMQTT */
#include "mqttmng.h"
#include "mqttmngConfig.h"
//=============================================================================

//=============================================================================
/*--------------------------------- Defines ---------------------------------*/
//=============================================================================

//=============================================================================

//=============================================================================
/*--------------------------------- Globals ---------------------------------*/
//=============================================================================
static int32_t svmqttStatus = 1;

static SemaphoreHandle_t mutex;
//=============================================================================

//=============================================================================
/*-------------------------------- Prototypes -------------------------------*/
//=============================================================================
static int32_t taskSvqmttInit(void);
static int32_t taskSvmqttLock(uint32_t timeout);
static void taskSvmqttUnlock(void);
//=============================================================================

//=============================================================================
/*---------------------------------- Task -----------------------------------*/
//=============================================================================
//-----------------------------------------------------------------------------
void taskSvmqtt(void *param){

    if( taskSvqmttInit() != 0 ) exit (-1);

    while(1){
        mqttmngRun();
    }
}
//-----------------------------------------------------------------------------
//=============================================================================

//=============================================================================
/*---------------------------- Static functions -----------------------------*/
//=============================================================================
//-----------------------------------------------------------------------------
static int32_t taskSvqmttInit(void){
    
    int32_t status;

    mutex = xSemaphoreCreateMutex();
    if( mutex == NULL ) return -1;

    status = mqttmngInit(taskSvmqttLock, taskSvmqttUnlock);

    return status;
}
//-----------------------------------------------------------------------------
static int32_t taskSvmqttLock(uint32_t timeout){

    if( xSemaphoreTake(mutex, timeout) != pdTRUE ) return -1;

    return 0;
}
//-----------------------------------------------------------------------------
static void taskSvmqttUnlock(void){
    
    xSemaphoreGive(mutex);
}
//-----------------------------------------------------------------------------
//=============================================================================
